## conf/layer.conf
```bitbake
BBPATH .= ":${LAYERDIR}"

BBFILES += "${LAYERDIR}/recipes-*/*/*.bb ${LAYERDIR}/recipes-*/*/*.bbappend"

BBFILE_COLLECTIONS += "iot-web"
BBFILE_PATTERN_iot-web := "^${LAYERDIR}/"
BBFILE_PRIORITY_iot-web = "9"
```
